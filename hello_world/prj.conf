## prj.conf
```kconfig
# nothing here
CONFIG_THREAD_NAME=y
```

## src/main.c
```c
/*
 * Copyright (c) 2012-2014 Wind River Systems, Inc.
 *
 * SPDX-License-Identifier: Apache-2.0
 */


#include <zephyr/kernel.h>
#include <stdio.h>

int main(void)
{
	while(1){
		printf("Hello World! %s\n", CONFIG_BOARD_TARGET);
		k_msleep(500);
	}


	return 0;
}
```
